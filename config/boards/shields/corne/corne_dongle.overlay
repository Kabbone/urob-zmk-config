/*
 * Copyright (c) 2020 Pete Johanson
 *
 * SPDX-License-Identifier: MIT
 */

#include "corne.dtsi"

/ {
    chosen {
        zmk,kscan = &mock_kscan;
        zmk,matrix-transform = &default_transform;
    };

    mock_kscan: kscan_0 {
        col-gpios
        = <&pro_micro 1 GPIO_ACTIVE_HIGH>;
	compatible = "zmk,kscan_mock";
        columns = <0>;
        rows = <0>;
        events = <0>;
    };
};
