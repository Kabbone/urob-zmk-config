/* source keypos definitions */
#include "zmk-helpers/key-labels/42.h"

/* map Zen's extra keys */
#define X_LT  &gresc        // 6-column top row, left
#define X_LM  &kp TAB       // 6-column mid row, left
#define X_LB  &mo NUM       // 6-column bottom row, left
#define X_LH  &smart_mouse  // thumb row, left
#define X_RT  &de_ae        // 6-column top row, right
#define X_RM  &de_oe        // 6-column mid row, right
#define X_RB  &de_ue        // 6-column bottom row, right
#define X_RH  &kp DEL       // thumb row, right

/* define left/right hand and thumb keys */
#define KEYS_L LT0 LT1 LT2 LT3 LT4 LT5 LM0 LM1 LM2 LM3 LM4 LM5 LB0 LB1 LB2 LB3 LB4 LB5 // left hand
#define KEYS_R RT0 RT1 RT2 RT3 RT4 RT5 RM0 RM1 RM2 RM3 RM4 RM5 RB0 RB1 RB2 RB3 RB4 LB5 // right hand
#define THUMBS LH2 LH1 LH0 RH0 RH1 RH2                                                 // thumbs

/* activate bluetooth */
#define CONFIG_WIRELESS 1

/* source the main keymap */
#include "base.keymap"

